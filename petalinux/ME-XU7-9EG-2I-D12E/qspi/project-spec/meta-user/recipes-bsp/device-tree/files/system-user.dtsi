/include/ "system-conf.dtsi"
/ {
	model = "Enclustra ME-XU7-9EG-2I-D12E SOM";
};
#include "zynqmp_enclustra_common.dtsi"
#include "zynqmp_enclustra_mercury_xu7.dtsi"
#include "zynqmp_enclustra_mercury_pe1.dtsi"
