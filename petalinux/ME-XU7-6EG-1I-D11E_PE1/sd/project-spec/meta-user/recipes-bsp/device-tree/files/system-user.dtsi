/include/ "system-conf.dtsi"
/ {
	model = "Enclustra ME-XU7-6EG-1I-D11E SOM";
};
#include "zynqmp_enclustra_common.dtsi"
#include "zynqmp_enclustra_mercury_pe1.dtsi"
#include "zynqmp_enclustra_mercury_xu7.dtsi"
